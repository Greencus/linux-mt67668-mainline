// SPDX-License-Identifier: GPL-2.0-only
/*
 * mt6769t-samsung-a32-bt.dtsi -- A32 Bluetooth (Track B, BTIF) fragment.
 *
 * Wiring (gated): add one line to mt6769t-samsung-a32.dts once the
 * hardware gates close (TODO-BTIF):
 *
 *     #include "mt6769t-samsung-a32-bt.dtsi"
 *
 * The board .dts is intentionally NOT modified by the Track B change;
 * this fragment is inert until included.
 *
 * Transport truth: BTIF is the compile-time default (connac2/Makefile:28
 * -DCHIP_IF_BTIF, selector btmtk_chip_if.h:25). The BTIF path needs NO
 * UART node, so this fragment deliberately contains NO serdev / ttyMT
 * instance. A ttyMT wiring would need exact downstream evidence
 * (which UART instance + baud + conninfra power strings); none is in
 * the tree, so none is invented here -- any future serdev addition
 * must cite that evidence or be marked TODO (TODO-UART-LEG).
 *
 * Power: NO regulator names, voltages, or GPIO numbers are invented.
 * vcc-supply / reset-gpios are left ABSENT; the driver treats both as
 * optional and logs TODO-POWER when missing. Uncomment and fill them
 * only from measured/vendor-derived values.
 *
 * Wakeup IRQ (§3): downstream resolves BOTH BT logical IRQs from DT --
 * irq_of_parse_and_map() on compatible "mediatek,bt", index 0 =
 * BTIF_WAKEUP_IRQ (FW has data) / index 1 = BGF_SW_IRQ (FW assert/log)
 * with IRQF_TRIGGER_HIGH|IRQF_SHARED (connac2/btmtk_irq.c:239-290), named
 * "BTIF_WAKEUP_IRQ"/"BGF_SW_IRQ" (btmtk_irq.c:39-40), owner CONSYS_BT
 * (btmtk_btif_main.c:46), requested-then-masked at bring-up
 * (btmtk_mt66xx.c:1139-1149). Mainline routing substrate here is the MT6768
 * GIC-V3 + sysirq intpol + pinctrl-mt6768 EINT (mt6768.dtsi: root
 * interrupt-parent = <&sysirq>, gic node, pio pinctrl@10005000); the
 * interrupt-parent for this node is INHERITED from / (mt6768.dtsi:19),
 * so no interrupt-parent is written here.
 *
 * TODO-HWIRQ (hardware-confirm, blocks "okay"): NO numeric `interrupts`
 * property is written -- none is evidenced for A32. Downstream's own
 * "mediatek,bt" nodes carry NO interrupts property at all (e.g.
 * downstream mt6833/mt6853.dts: only pm_qos_support); the sibling
 * "mediatek,btif" SPIs on OTHER SoCs (e.g. GIC_SPI 158/152/153 on mt6833)
 * are not A32 evidence; the MT_BGF2AP_BTIF_WAKEUP_IRQ_ID 312 /
 * MT_BGF2AP_SW_IRQ_ID 271 constants are downstream-marked "temp"
 * (btmtk_btif.h:61-62); and mainline mt6768.dtsi has NO consys/btif/bt
 * node to inherit a number from. The numeric specifiers (in
 * interrupt-names order: wakeup first, SW second) land here ONLY from a
 * hardware-confirmed A32 CONNSYS->GIC/sysirq routing. Until then the
 * driver resolves both lines by name and keeps them unarmed
 * (HARDWARE-UNPROVEN).
 *
 * IRQ mapping verdict (§3, traced -- NOT wired because nothing maps):
 * the connsys evidence (downstream mt6768.dts `consys@18002000`,
 * kernel/downstream/) decodes as BGF_EINT = GIC_SPI 284, WDT_EINT =
 * GIC_SPI 78, conn2ap_sw_irq = GIC_SPI 287 -- all three are
 * CONNSYS-level lines owned by the conninfra driver, NOT the BT
 * driver's BGF2AP_BTIF_WAKEUP_IRQ / BGF2AP_SW_IRQ. The BT driver's lines
 * resolve from DTS indices of the compatible "mediatek,bt" node
 * (bt_request_irq: index 0 = wakeup / 1 = SW, btmtk_irq.c:249-269), and
 * that node DOES NOT EXIST on mt6768 downstream (only a
 * "mediatek,btif" node at GIC_SPI 133 + DMA IRQs) -- on A32 silicon the
 * downstream lookup itself fails ("get bt device node fail"). So 284 /
 * 78 / 287 are PROVEN consys-owned and PROVEN NOT BT-driver lines:
 * wiring any of them here would be invention. TODO-HWIRQ stays until
 * the actual A32 BGF2AP->GIC routing is confirmed on hardware.
 *
 * §1 production resources (ALL evidenced, nothing invented):
 * - BTIF PIO window: reg 0x1100c000/0x1000 + GIC_SPI 133 LEVEL_LOW
 *   ("btif irq"), clocks "btifc"/"apdmac" -- downstream mt6768.dts
 *   `btif@1100c000` node (kernel/downstream/), whose trigger the
 *   downstream BTIF driver itself reads back from the `interrupts`
 *   specifier (btif_plat.c:_btif_set_default_setting). The TX/RX DMA
 *   windows (0x11000b80/0x80, 0x11000c00/0x80) and DMA IRQs (115/141)
 *   are deliberately NOT carried: DMA stays TODO (TODO-DMA) and
 *   unrequested lines must not be claimed. Mainline provides both
 *   clock gates (clk-mt6768.c: CLK_INFRA_BTIF "ifr_btif" / CLK_INFRA_AP_DMA
 *   "ifr_ap_dma"; binding header mediatek,mt6768-clk.h) consumed from
 *   the existing &infracfg_ao provider.
 * - CONN_HOST_CSR window 0x18060000/0x1000 (BGF_LPCTL/IRQ_STAT/IRQ_STAT2
 *   for the FW-own handshake) and BGF window 0x18800000/0x1000
 *   (BGF_SW_IRQ_STATUS/RESET_ADDR) -- downstream connac2
 *   btmtk_mt66xx_reg.h:101-102 (:245 BGFSYS_BASE), kernel/downstream/.
 * - EMI pool: memory-region = <&consys_reserve> -- the SAME 0x440000
 *   pool the W4 stack uses for FW patch/log/coredump EMI
 *   (mt6769t-samsung-a32.dts consys node; wmt_allocate_connsys_emi
 *   parses "memory-region"). BT/MCU sub-offsets come from the patch
 *   headers at runtime (verified against the pool size, never blind).
 */

/ {
	bluetooth-a32 {
		/* New A32-specific compatible for the btmtk-a32 platform
		 * driver. NOT "mediatek,mt6631-bluetooth": no such upstream
		 * binding exists and claiming one would be fabrication.
		 * A future upstream mt6631 binding can subsume this node.
		 */
		compatible = "mediatek,mt6768-bt-a32";
		/* HARDWARE-UNPROVEN gate: stays disabled until controller
		 * discovery + firmware download + basic HCI up are proven
		 * on A32 silicon. Flip to "okay" only then.
		 */
		status = "disabled";

		/* §1 production windows. Order is binding-local
		 * (reg-names); addresses evidenced per the header comment.
		 * The parent bus supplies #address-cells=<2>/#size-cells=<2>
		 * (downstream style <0 addr 0 size>).
		 */
		reg = <0x0 0x1100c000 0x0 0x1000>, /* btif: PIO window */
		      <0x0 0x18060000 0x0 0x1000>, /* csr: CONN_HOST_CSR */
		      <0x0 0x18800000 0x0 0x1000>; /* bgf: BGFSYS status */
		reg-names = "btif", "csr", "bgf";

		/* §1 BTIF-block IRQ (evidenced: downstream "btif irq").
		 * interrupt-names carries ONLY evidenced lines: the BGF2AP
		 * "wakeup"/"sw" names stay documented-pending (comment below)
		 * with NO specifier until TODO-HWIRQ closes -- names and
		 * specifiers are positional, so unwired names must not be
		 * listed. Trigger comes from the specifier itself (downstream
		 * BTIF driver pattern); the GIC parent is inherited from /.
		 */
		interrupts = <GIC_SPI 133 IRQ_TYPE_LEVEL_LOW>;
		interrupt-names = "btif";
		wakeup-source;

		/* TODO-HWIRQ (pending names, NO specifiers): downstream
		 * BGF2AP index 0 = "wakeup" (FW has data), index 1 = "sw"
		 * (FW assert/log) of the compatible "mediatek,bt" node
		 * (btmtk_irq.c:249-269) -- that node does not exist on
		 * mt6768, so no specifier is written. The driver still
		 * resolves both names (logs TODO-HWIRQ, keeps them unarmed).
		 */

		/* §1 clocks (evidenced both ends: downstream clock-names +
		 * mainline clk-mt6768 gates). Prepared at probe, enabled at
		 * open, disabled at close (downstream hal_btif_clk pattern).
		 */
		clocks = <&infracfg_ao CLK_INFRA_BTIF>,
			 <&infracfg_ao CLK_INFRA_AP_DMA>;
		clock-names = "btifc", "apdmac";

		/* §1 EMI pool for the firmware commit (same pool the W4
		 * stack uses; sub-offsets per patch header, size-checked).
		 */
		memory-region = <&consys_reserve>;

		/* Firmware consumed (short basenames, no mediatek/ prefix;
		 * expected under /lib/firmware/ -- cf. btmtk-a32.h):
		 *   soc1_0_ram_bt_1a_1_hdr.bin
		 *   soc1_0_patch_mcu_1a_1_hdr.bin
		 *   soc1_0_ram_mcu_1a_1_hdr.bin
		 * Post-HCI replay (NOT a loader blob):
		 *   BT_FW.cfg  (autobt script, TODO-AUTOBT)
		 */

		/* TODO-POWER: fill ONLY from measured/vendor-derived data:
		 *   vcc-supply = <&...>;
		 *   reset-gpios = <&pio ... GPIO_ACTIVE_LOW>;
		 */
	};
};
